## sdkconfig.defaults
```kconfig
# Override some defaults so BT stack is enabled
# in this example

# Target chip (required for esp_tinyusb; use esp32s3 for this project)
CONFIG_IDF_TARGET="esp32s3"

# Use custom partition table that includes the "storage" SPIFFS partition
CONFIG_PARTITION_TABLE_CUSTOM=y
CONFIG_PARTITION_TABLE_CUSTOM_FILENAME="partitions.csv"

# Flash size: partition table is for 16MB (see partitions.csv). Serial Flasher Config.
CONFIG_ESPTOOLPY_FLASHSIZE_16MB=y

#
# BT config
#
CONFIG_BT_ENABLED=y
CONFIG_BTDM_CONTROLLER_MODE_BLE_ONLY=y
CONFIG_BTDM_CONTROLLER_MODE_BR_EDR_ONLY=
CONFIG_BTDM_CONTROLLER_MODE_BTDM=
CONFIG_BT_BLE_42_FEATURES_SUPPORTED=y

#
# ESP32-specific config
#
CONFIG_ESP32_ENABLE_STACK_BT=y
# CONFIG_ESP32_ENABLE_STACK_NONE is not set
CONFIG_MEMMAP_BT=y

#
# Some performance tweaks
#
CONFIG_ESP32_REV_MIN_1=y
CONFIG_ESP32_DEFAULT_CPU_FREQ_240=y
CONFIG_ESP32_DEFAULT_CPU_FREQ_MHZ=240
CONFIG_FREERTOS_HZ=1000
# Disable halt on SMP-untested FreeRTOS API (BLE/IDF can call these; halt looks like a freeze)
# CONFIG_FREERTOS_ASSERT_ON_UNTESTED_FUNCTION is not set
CONFIG_OPTIMIZATION_LEVEL_RELEASE=y
CONFIG_OPTIMIZATION_ASSERTIONS_ENABLED=y

#
# USB MIDI
#

CONFIG_TINYUSB=y
CONFIG_TINYUSB_MIDI_ENABLED=y
CONFIG_TINYUSB_DESC_MANUFACTURER_STRING="Balute"
CONFIG_TINYUSB_DESC_PRODUCT_STRING="eTar"
CONFIG_TINYUSB_DESC_CDC_STRING="eTar CDC Device"
CONFIG_TINYUSB_DESC_MIDI_STRING="eTar MIDI Device"
CONFIG_TINYUSB_MIDI_COUNT=1

#
# USB CDC
#

CONFIG_USB_DESC_MANUFACTURER_STRING="Balute"
CONFIG_USB_DESC_PRODUCT_STRING="eTar"
CONFIG_USB_DESC_CDC_STRING="eTar CDC Device"


#
# HTTP server: allow longer request headers (browser form uploads need more than 512)
#
CONFIG_HTTPD_MAX_REQ_HDR_LEN=4096
CONFIG_HTTPD_MAX_URI_LEN=1024

#
# CONSOLE
#

CONFIG_ESP_CONSOLE_UART=y
CONFIG_ESP_CONSOLE_UART_NUM=0
CONFIG_ESP_CONSOLE_UART_BAUDRATE=115200
CONFIG_ESP_CONSOLE_SECONDARY_USB_SERIAL_JTAG=y
```
